 /* 1.此次的更新，首先采用了v2.0版本SPI的屏显接线方式，使得OLED与板子的接线更加紧凑方便；
  * 2.考虑到外壳包装的设计成本，所以暂时采用DHT22传感器进行实验；
  * 3.反控方面采用了一颗1W的绿光LED灯进行效果的展示；
  * 4.接线方式:|---------------|-----------------|------------------|------------ ----|
  *            | Nodemcu       |OLED             |DHT22             |LED              |
               |---------------|-----------------|------------------|-----------------|
               | GPIO16        |CS  -CS                                               |
               | GPIO05        |DC  -DC                                               |
               | GPIO4         |RES -RES                                              |
               | GPIO0         |D1  -MOSI                                             |
               | GPIO2         |D0  -CLK                                              |
               |---------------|-----------------|------------------------------------| 
               | GPIO13                          |Data                                |
               | 3.3V                            |vcc                                 |
               | GND                             |gnd                                 |
               |---------------------------------|-------------------|----------------|
               | GPIO15                                              | +              |
               | GND                                                 | -              |
               |-----------------------------------------------------|----------------|
   注意：本案列采用Adafruit_SSD1306.h库文件，不能直接使用，需要进行文件修改(本例OLED是SSD1306_128_64）)，解决方法:
        1.进入Arduino库文件夹，打开Adafruit_SSD1306.h (使用任意文本编辑器打开)
        2.找到行：#define SSD1306_128_32
        3.取消改行的注释: #define SSD1306_128_64
        4.在Arduino中打开实例文件： ssd1306_128x64_i2c
        5.在setup函数中将地址从0x3D更改为0x3C
        为避免取模后出现错误显示，取模时进行设置：1.横向取模；2.保留最后一个逗号；3.只在字母前加0；
*/
/********************库文件引用*****************************************/
#include <SPI.h>
#include <Wire.h>
#include <Adafruit_GFX.h>
#include <Adafruit_SSD1306.h>

#include "DHT.h"
#include <ESP8266WiFi.h>
#include <ArduinoJson.h>
#include <PubSubClient.h>
/*****************************网络初始化****************************/
#define WIFI_SSID "TCGW"       // 使用时请修改为当前你的 wifi ssid
#define WIFI_PASS "tcgw1234"   // 使用时请修改为当前你的 wifi 密码                        
const char* mqtt_server = "139.224.9.212";
WiFiClient espClient;
PubSubClient client(espClient);
/******************************************************************/
#define GPIO0 15              //gpio2引脚
#define GPIO0_PIN 15
int status = WL_IDLE_STATUS;
boolean gpioState[] = {false, false};
/********************oled初始化*********************************/
#define OLED_MOSI  0 //D1
#define OLED_CLK   2 //D0
#define OLED_DC    5
#define OLED_CS    16
#define OLED_RESET 4
Adafruit_SSD1306 display(OLED_MOSI, OLED_CLK, OLED_DC, OLED_RESET, OLED_CS);
/********************DHT22初始化*********************************/
#define DHTPIN  13       
#define DHTTYPE DHT22     
DHT dht(DHTPIN, DHTTYPE);  
/********************变量初始化*********************************/
float humidity,humiditybuf;
float temperature,temperaturebuf;
long lastMsg = 0;
long lastPub = 0;
char msg[50];

static const unsigned char PROGMEM Gateway[] = {
0xFF,0xFF,0xFF,0xFF,0xFF,0xFF,0xFF,0xFF,0xFF,0xFF,0xFF,0xFF,0xFF,0xFF,0xFF,0xFF,
0xFF,0xFF,0xFF,0xFF,0xFF,0xFF,0xFF,0xFF,0xFF,0xFF,0xFF,0xFF,0xFF,0xFF,0xFF,0xFF,
0xFF,0xFF,0xFF,0xFF,0xFF,0xFF,0xFF,0xFF,0xFF,0xFF,0xFF,0xFF,0xFF,0xFF,0xFF,0xFF,
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0xFF,0xFF,0xFF,0xFF,0xFF,0xFF,0xFF,0xFF,0xFF,0xFF,0xFF,0xFF,0xFF,0xFF,0xFF,0xFF,
  };
  static const unsigned char PROGMEM Kuang[] = {
0xFF,0xFF,0xFF,0xFF,0xFF,0xFF,0xFF,0xFF,0xFF,0xFF,0xFF,0xFF,0xFF,0xFF,0xFF,0xFC,
0x80,0x00,0x00,0x00,0x00,0x00,0x00,0x00,0x00,0x00,0x00,0x00,0x00,0x00,0x00,0x04,
0x80,0x00,0x00,0x00,0x00,0x00,0x00,0x00,0x00,0x00,0x00,0x00,0x00,0x00,0x00,0x04,
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0xFF,0xFF,0xFF,0xFF,0xFF,0xFF,0xFF,0xFF,0xFF,0xFF,0xFF,0xFF,0xFF,0xFF,0xFF,0xFC,};\
static const unsigned char PROGMEM Kuang2[] = {
0xFF,0xFF,0xFF,0xFF,0xFF,0xFF,0xFF,0xFF,0xFF,0xFF,0xFF,0xFF,0xFF,0xFF,0xFF,0xFF,
0xE0,0x00,0x00,0x00,0x00,0x00,0x00,0x00,0x00,0x00,0x00,0x00,0x00,0x00,0x00,0x07,
0xE0,0x00,0x00,0x00,0x00,0x00,0x00,0x00,0x00,0x00,0x00,0x00,0x00,0x00,0x00,0x07,
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0xFF,0xFF,0xFF,0xFF,0xFF,0xFF,0xFF,0xFF,0xFF,0xFF,0xFF,0xFF,0xFF,0xFF,0xFF,0xFF,
};
/***********************************************************/
void setup(void) {
  Wire.begin(12, 13); 
  Serial.begin(9600);
  dht.begin();

  pinMode(GPIO0, OUTPUT);
  digitalWrite(GPIO0,LOW);
  delay(10);
        
  display.display();
  pinMode(16,OUTPUT);
  display.begin(SSD1306_SWITCHCAPVCC);    
  delay(2000);    
  display.clearDisplay(); // Clear the display buffer.
  display.drawPixel(10, 10, WHITE);
  display.display();
  delay(2000);
  display.clearDisplay();

  WiFi.begin(WIFI_SSID, WIFI_PASS);     
  client.setServer(mqtt_server,1883); 
  client.setCallback(on_message);
  delay(2000);
  Serial.println(F("[Debug]:初始化完成..."));
}


void loop(){  
    while (!client.connected()) {
       if (WiFi.status() != WL_CONNECTED) {                                       
              Serial.println(F("[Debug]:请连接Wifi..."));
              display.setTextColor(BLACK,WHITE );
              display.setTextSize(1);
              display.drawBitmap(0, 0, Gateway, 128, 19, 1);
              display.setTextColor(WHITE,BLACK);
              display.setTextSize(1);
              display.setCursor(0, 31);
              display.print("     SSID: TCGW"); 
              display.setCursor(0, 46);
              display.print("   PSWD: tcgw1234"); 
              display.display();
              display.clearDisplay();  
              delay(3500);
              
              WiFi.begin(WIFI_SSID, WIFI_PASS);
               /*  while (WiFi.status() != WL_CONNECTED) {
                      delay(500);
                      Serial.print(".");
                      }*/
                 }            
        if ( client.connect("ESP8266 Device","LOCBx798RQ39ByN05LVd", NULL) ) {// Attempt to connect (clientId, username, password)
              Serial.println( "[DONE]" );// Subscribing to receive RPC requests
              client.subscribe("v1/devices/me/rpc/request/+");// Sending current GPIO status
              Serial.println(F("发送现在的GPIO口状态："));
              client.publish("v1/devices/me/attributes", get_gpio_status().c_str());
            }
        }
        client.loop();  



        long now =millis();
        if(now-lastMsg>1000){
              lastMsg = now;     
              digitalWrite(16,HIGH);           
              humidity = dht.readHumidity();
              temperature = dht.readTemperature();
              if(!isnan(temperature) && !isnan(humidity)){ /*数据采集，采集的过程中会出现采集失败“nan”的正常状况，所以采用缓存来避免“nan”值的显示*/
                    
                    temperaturebuf = temperature;
                    humiditybuf = humidity;
                    Serial.print(F("温度："));
                    Serial.print(temperature);
                    Serial.print(F("  湿度："));
                    Serial.println(humidity);
              } else{
                    Serial.print(F("温度(buf)："));
                    Serial.print(temperaturebuf);
                    Serial.print(F("  湿度(buf)："));
                    Serial.println(humiditybuf);
                    }
      
                    /*屏幕第一行的显示*/
                    display.setTextColor(BLACK,WHITE );
                    display.setTextSize(1);
                    display.setCursor(0, 0);
                    display.print("                     ");
                    display.setCursor(0, 2);
                    display.print("     DHT-DEMO 05       ");
                    /*第二行标签的显示*/
                    display.setTextSize(1);
                    display.setTextColor( WHITE,BLACK);
                    display.setCursor(0, 10);
                    display.print("                     ");
                    display.setCursor(5, 13);
                    display.print("TEMP(c)");
                    display.setCursor(84, 13);
                    display.print("HUMI(%)");
                    display.setTextColor(WHITE,BLACK);
                    //display.setCursor(0, 20);
                    display.drawBitmap(0, 10, Kuang, 128, 15, 1);
                    display.drawBitmap(0, 0, Kuang2, 128, 64, 1);
                    //display.print("---------------------");
                    /*第三行温湿度的显示*/
                    display.setTextSize(2);
                    display.setCursor(5, 38);
                    if(!isnan(temperature)){
                        display.print(temperature,1);
                    }else{
                        display.print(temperaturebuf,1);}
                    display.setTextSize(2);
                    display.setCursor(76, 38);
                    if(!isnan(humidity)){
                        display.print(humidity,1);
                    }else{
                        display.print(humiditybuf,1);}
                    display.display();
                    display.clearDisplay();  
                                                                                                    
                    if (now - lastPub >15000 && !isnan(dht.readTemperature())) {                                        
                           lastPub = now + 14000; 
                           client.connect("LOCBx798RQ39ByN05LVd","LOCBx798RQ39ByN05LVd",""); 
                           String payload = "{";                     
                           payload += "\"TEMP\":"; 
                           payload += temperature;                            
                           payload += ",";
                           payload += "\"HUMI\":"; 
                           payload += humidity;
                           payload += "}";
                           char attributes[300];                         
                           payload.toCharArray( attributes, 100 );       
                           client.publish( "v1/devices/me/telemetry", attributes );      
                           Serial.print(F("[Debug]:发布成功,内容为: "));                                  
                           digitalWrite(16,LOW); 
                           Serial.println(attributes);    
                           } 
                     // delay(1000);
                      }
             }





void on_message(const char* topic, byte* payload, unsigned int length) {
    Serial.println("On message");
    char json[length + 1];
    strncpy (json, (char*)payload, length);
    json[length] = '\0';
  
    Serial.print(F("标题为: "));
    Serial.println(topic);
    Serial.print(F("信息: "));
    Serial.println(json);
  
    StaticJsonBuffer<200> jsonBuffer;
    JsonObject& data = jsonBuffer.parseObject((char*)json);
   /****************Debug**************************
    if (!data.success()){Serial.println("parseObject() failed");return; }*/
    String methodName = String((const char*)data["method"]);
    if (methodName.equals("getGpioStatus")) {   //获取引脚状态
          String responseTopic = String(topic);
          responseTopic.replace("request", "response");
          client.publish(responseTopic.c_str(), get_gpio_status().c_str());
          
    }else if(methodName.equals("setGpioStatus")) {  //设置引脚状态
          set_gpio_status(data["params"]["pin"], data["params"]["enabled"]);
          String responseTopic = String(topic);
          responseTopic.replace("request", "response");
          client.publish(responseTopic.c_str(), get_gpio_status().c_str());
          client.publish("v1/devices/me/attributes", get_gpio_status().c_str());
          } 
      }

String get_gpio_status() {
      StaticJsonBuffer<200> jsonBuffer;
      JsonObject& data = jsonBuffer.createObject();
      data[String(GPIO0_PIN)] = gpioState[0] ? true : false;
      char payload[256];
      data.printTo(payload, sizeof(payload));
      String strPayload = String(payload);
      Serial.print(F("当前Gpio状态为: "));
      Serial.println(strPayload);
      return strPayload;
      }

void set_gpio_status(int pin, boolean enabled) {
      if (pin == GPIO0_PIN) {
          digitalWrite(GPIO0, enabled ? HIGH : LOW); 
          gpioState[0] = enabled;
          }
      }











   

/*
static const unsigned char PROGMEM Du[] = {//24x21
0x03,0x00,0x00,0x07,0x87,0xC0,0x06,0x9E,0xE8,0x07,0x98,0x38,0x03,0x30,0x18,0x00,
0x30,0x08,0x00,0x60,0x00,0x00,0x60,0x00,0x00,0x60,0x00,0x00,0x60,0x00,0x00,0x60,
0x00,0x00,0x30,0x00,0x00,0x30,0x08,0x00,0x18,0x38,0x00,0x0F,0xF0,0x00,0x07,0xC0,
0x12,0x00,0x00,0x00,0x01,0x00,0x00,0x00,0x02,0x00,0x00,0x00,0x31,0x36,0x00,
};
static const unsigned char PROGMEM Bai[] = {
0x00,0x00,0x00,0x0E,0x00,0xC0,0x1F,0x01,0xC0,0x19,0x03,0x80,0x19,0x07,0x00,0x19,
0x0E,0x00,0x19,0x1C,0x00,0x1F,0x38,0x00,0x0E,0x73,0x80,0x00,0xE7,0xC0,0x01,0xC4,
0xC0,0x03,0x84,0xC0,0x07,0x04,0xC0,0x0E,0x04,0xC0,0x0C,0x07,0xC0,0x00,0x03,0x80,
0x08,0x62,0x39,0x02,0x08,0x62,0x39,0x02,0x7C,0x06,0x00,0x00,0x10,0x00,0x00,};

第四行显示单位
display.setTextSize(1);
display.drawBitmap(9, 49, Du, 21, 21, 1);
display.drawBitmap(91, 48, Bai, 21, 21, 1);
*/
         /*避免过多的nan值显示而引用的测试代码：
       * client.loop();                                                     //MCU接收数据的主循环函数
        long now = millis();                                               //millis()函数从程序开始处返回毫秒
        if (now - lastmsg >5000 && !isnan(dht.readTemperature())) {                                         //每隔1秒发一次信号       
              lastmsg = now; 
               
               if(WiFi.status() != WL_CONNECTED){
                      Serial.println(F("[Debug]:WiFi未连接..."));
               }else{ Serial.println(F("[Debug]:WiFi已连接，即将连接服务..."));}
               client.connect("aH1oVsTHng8LZUKTxi55","aH1oVsTHng8LZUKTxi55",""); 
               if (!client.connected()) {                                         
                      Serial.println(F("[Debug]:MQTT服务未连接..."));                                                
               }else{
                      Serial.println(F("[Debug]:MQTT连接成功..."));                       
                       String payload = "{";                       //构建一个 JSON 格式的payload的字符串   
                       payload += "\"TEMP\":"; 
                       payload += temperature;                             //引入温度变量
                       payload += ",";
                       payload += "\"HUMI\":"; 
                       payload += humidity;
                       payload += "}";
                       
                       char attributes[300];                         //发布主题的内容长度
                       payload.toCharArray( attributes, 100 );       //将pyload字串指向变量attributes
                       client.publish( "v1/devices/me/telemetry", attributes );      //发布的主题名称及存储在json格式payload下的字串（主题名可更改）
                       Serial.print(F("[Debug]:发布成功,内容为: "));                                  //串口打印发布的信息
                       digitalWrite(16,LOW); 
                       Serial.println(attributes);    
                       } 
                 } 
                 delay(1000);*/
